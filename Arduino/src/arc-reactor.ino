#include <Adafruit_NeoPixel.h>

#ifdef __AVR_ATtiny85__ // Trinket, Gemma, etc.
 #include <avr/power.h>
#endif

// pin where you connected the NeoPixel ring DataIn pin
const uint8_t PIN = 1;

// 24 for the ring, 7 for the disc
const uint8_t LEDs = 31;

// scale this down if you're using transparent plastic
const uint8_t maxBrightness = 255;

// initial delay between pixel shift during startup
const uint8_t delay_ms_init = 25;


Adafruit_NeoPixel pixels = Adafruit_NeoPixel(LEDs, PIN);

/* this array generated by breathe.py
using LED 'breathing' function by Sean Voisen.
http://sean.voisen.org/blog/2011/10/breathing-led-with-arduino/ */
const uint8_t numSteps = 128;
const uint32_t breath[numSteps] PROGMEM = {
  0x000000, 0x000000, 0x000000, 0x000000, 0x000000, 0x000000, 0x000000, 0x000000,
  0x000000, 0x000000, 0x000001, 0x000101, 0x000101, 0x000102, 0x000102, 0x000202,
  0x000203, 0x000203, 0x010304, 0x010304, 0x010405, 0x010405, 0x010406, 0x010506,
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  0x3ECBF9, 0x3ECCFA, 0x3FCDFB, 0x3FCEFC, 0x3FCEFD, 0x3FCFFE, 0x3FCFFE, 0x3FCFFE
};

void setup()
{
  #ifdef __AVR_ATtiny85__ // Trinket, Gemma, etc.
    if(F_CPU == 16000000) clock_prescale_set(clock_div_1);
  #endif

  pixels.begin();
  pixels.setBrightness(maxBrightness);
}

void startup()
{
  uint8_t i;
  uint8_t delay_ms = delay_ms_init;
  uint8_t scale = numSteps / delay_ms_init;

  while(delay_ms > 0)
  {

    uint32_t color = pgm_read_dword(
      breath + ( (delay_ms_init - delay_ms) * scale ) );

    // always keep the center LED on.
    pixels.setPixelColor(24, color);

    for(i = 0; i < 24; i++)
    {
      //rotate clockwise on the ring.
      pixels.setPixelColor(i, color);

      //rotate counterclockwise in the center.
      pixels.setPixelColor(30 - (i % 6), color);

      pixels.show();
      delay(delay_ms);
      pixels.clear();
    }

    delay_ms--;
  }

  // full on brightness for a few seconds
  for(i = 0; i < 31; i++)
  {
    pixels.setPixelColor(i, pgm_read_dword(breath + numSteps - 1));
  }
  pixels.show();
  delay(3000);
}

void breathe()
{
  // assuming all lights are on already
  uint8_t i,j;
  int8_t direction = -1;

  while(true)
  {
    // loop over all the values in the array
    for(i = 0; i < numSteps; i++)
    {
      // loop over all the pixels in the ring (disc pixels stay constant)
      for(j = 0; j < 24; j++)
      {
        uint32_t color = direction == 1 ?
          pgm_read_dword(breath + i) :
          pgm_read_dword(breath + numSteps - i - 1);

        pixels.setPixelColor(j, color);
      }
      pixels.show();
      delay(15);

    }
    direction *= -1;
  }
}

void loop()
{
  startup();
  breathe();
}
